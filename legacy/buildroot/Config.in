## legacy/buildroot/Config.in
```kconfig
menu "MyOS packages"
source "$BR2_EXTERNAL_MYOS_PATH/package/myos-base/Config.in"
endmenu
```

## legacy/buildroot/configs/myos_qemu_x86_64_defconfig
```kconfig
BR2_x86_64=y
BR2_TOOLCHAIN_BUILDROOT_MUSL=y
BR2_KERNEL_HEADERS_AS_KERNEL=y
BR2_DOWNLOAD_FORCE_CHECK_HASHES=y
BR2_REPRODUCIBLE=y
BR2_TARGET_GENERIC_HOSTNAME="myos"
BR2_TARGET_GENERIC_ISSUE="MyOS 0.1 - development console"
BR2_INIT_BUSYBOX=y
BR2_TARGET_GENERIC_ROOT_PASSWD=""
BR2_TARGET_GENERIC_GETTY_PORT="ttyS0"
BR2_TARGET_GENERIC_GETTY_BAUDRATE_115200=y
BR2_ROOTFS_OVERLAY="$(BR2_EXTERNAL_MYOS_PATH)/board/qemu-x86_64/overlay"
BR2_LINUX_KERNEL=y
BR2_LINUX_KERNEL_LATEST_VERSION=y
BR2_LINUX_KERNEL_USE_CUSTOM_CONFIG=y
BR2_LINUX_KERNEL_CUSTOM_CONFIG_FILE="board/qemu/x86_64/linux.config"
BR2_LINUX_KERNEL_NEEDS_HOST_LIBELF=y
BR2_TARGET_ROOTFS_EXT2=y
BR2_TARGET_ROOTFS_EXT2_4=y
BR2_TARGET_ROOTFS_EXT2_LABEL="MYOS"
BR2_TARGET_ROOTFS_EXT2_SIZE="128M"
# BR2_TARGET_ROOTFS_TAR is not set
BR2_PACKAGE_MYOS_BASE=y
```

## legacy/buildroot/package/myos-base/Config.in
```kconfig
config BR2_PACKAGE_MYOS_BASE
	bool "myos-base"
	depends on BR2_INIT_BUSYBOX
	help
	  MyOS system information command and boot readiness check.
```
